// See https://zmk.dev/docs/development/hardware-integration/physical-layouts
// for how to configure this.
//
// NOTE: The actual physical layout used by this shield is defined directly
// in right_test.overlay as `physical_layout0`, since that is what the
// `chosen { zmk,physical-layout = ...; }` node points at. This file just
// pulls in the `key_physical_attrs` macro used to build that layout's
// `keys` property.

#include <physical_layouts.dtsi>
